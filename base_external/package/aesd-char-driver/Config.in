## base_external/package/aesd-char-driver/Config.in
```kconfig
config BR2_PACKAGE_AESD_CHAR_DRIVER
	bool "aesd-char-driver"
	help
	  Linux device drivers for AESD buildroot assignment 7
```

## base_external/package/ldd/Config.in
```kconfig
config BR2_PACKAGE_LDD
	bool "ldd"
	help
	  Linux device drivers for AESD buildroot assignment 7
```
